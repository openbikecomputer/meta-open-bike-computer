## conf/distro/openbikecomputer-os.conf
```bitbake
require conf/distro/poky.conf

DISTRO_FEATURES:append = " pam wayland x11 hwcodecs"

# Enable systemd
DISTRO_FEATURES:append = " systemd"
DISTRO_FEATURES_BACKFILL_CONSIDERED += "sysvinit"
VIRTUAL-RUNTIME_init_manager = "systemd"
VIRTUAL-RUNTIME_initscripts = "systemd-compat-units"

IMAGE_FSTYPES:append = " wic wic.bmap"
```

## conf/layer.conf
```bitbake
# We have a conf and classes directory, add to BBPATH
BBPATH .= ":${LAYERDIR}"

# We have recipes-* directories, add to BBFILES
BBFILES += "${LAYERDIR}/recipes-*/*/*.bb \
            ${LAYERDIR}/recipes-*/*/*.bbappend"

BBFILE_COLLECTIONS += "openbikecomputer"
BBFILE_PATTERN_openbikecomputer = "^${LAYERDIR}/"
BBFILE_PRIORITY_openbikecomputer = "6"

LAYERDEPENDS_openbikecomputer = "core"
LAYERSERIES_COMPAT_openbikecomputer = "kirkstone"

BBFILES_DYNAMIC += " \
    raspberrypi:${LAYERDIR}/dynamic-layers/raspberrypi/*/*/*.bb \
    raspberrypi:${LAYERDIR}/dynamic-layers/raspberrypi/*/*/*.bbappend \
    brytonrider860:${LAYERDIR}/dynamic-layers/brytonrider860/*/*/*.bb \
    brytonrider860:${LAYERDIR}/dynamic-layers/brytonrider860/*/*/*.bbappend \
"
```
